## package/matter-c/Config.in
```kconfig
config BR2_PACKAGE_MATTER_C
	bool "matter-c"
	depends on BR2_PACKAGE_MBEDTLS || BR2_PACKAGE_THINGINO_MBEDTLS
	help
	  matter-c is an independent Matter 1.6 protocol stack written
	  from scratch in pure C99. Portable, callback-driven architecture
	  designed for embedded systems with mbedTLS.

	  Provides core Matter protocols: PASE (SPAKE2+), CASE (SIGMA),
	  Interaction Model, TLV encoding, and DNS-SD discovery.
	  100% pure C with no C++ runtime dependencies.

	  https://github.com/esp-dev/matter-c

comment "matter-c needs mbedTLS"
	depends on !BR2_PACKAGE_MBEDTLS && !BR2_PACKAGE_THINGINO_MBEDTLS
```

## package/thingino-matter/Config.in
```kconfig
config BR2_PACKAGE_THINGINO_MATTER
	bool "thingino-matter"
	default n
	depends on BR2_PACKAGE_MBEDTLS || BR2_PACKAGE_THINGINO_MBEDTLS
	depends on BR2_PACKAGE_THINGINO_JCT
	depends on BR2_PACKAGE_THINGINO_AGENT
	help
	  Matter 1.5 camera service for Thingino firmware.
	  Provides a lightweight pure C daemon (matterd) exposing the onboard
	  camera feed via Matter 1.5 WebRTC transport provider cluster,
	  along with camera controls and motion events for Home Assistant
	  Matter integration.
	  Supports Raptor and TIMPS streamer backends.

	  https://github.com/themactep/thingino-firmware

comment "thingino-matter needs mbedTLS"
	depends on !BR2_PACKAGE_MBEDTLS && !BR2_PACKAGE_THINGINO_MBEDTLS
```
